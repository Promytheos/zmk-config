## boards/shields/vortex_corne/Kconfig.defconfig
```kconfig
# Copyright (c) 2022 The ZMK Contributors
# SPDX-License-Identifier: MIT

if SHIELD_VORTEX_CORNE_CENTER

config ZMK_KEYBOARD_NAME
    default "Vortex Corne"

config ZMK_SPLIT_ROLE_CENTRAL
    default y

endif # SHIELD_VORTEX_CORNE_CENTER

if SHIELD_VORTEX_CORNE_LEFT || SHIELD_VORTEX_CORNE_RIGHT || SHIELD_VORTEX_CORNE_CENTER

config ZMK_SPLIT
    default y

config ZMK_DISPLAY

if ZMK_DISPLAY

config SSD1306
    default y

config I2C
    default y

endif # ZMK_DISPLAY

if LVGL

config LV_Z_VDB_SIZE
    default 64

config LV_DPI_DEF
    default 148

config LV_Z_BITS_PER_PIXEL
    default 1

choice LV_COLOR_DEPTH
    default LV_COLOR_DEPTH_1
endchoice

endif # LVGL

endif # SHIELD_VORTEX_CORNE_LEFT || SHIELD_VORTEX_CORNE_RIGHT || SHIELD_VORTEX_CORNE_CENTER
```

## boards/shields/vortex_corne/Kconfig.shield
```kconfig
# Copyright (c) 2022 The ZMK Contributors
# SPDX-License-Identifier: MIT

config SHIELD_VORTEX_CORNE_CENTER
    def_bool $(shields_list_contains,vortex_corne_center)

config SHIELD_VORTEX_CORNE_LEFT
    def_bool $(shields_list_contains,vortex_corne_left)

config SHIELD_VORTEX_CORNE_RIGHT
    def_bool $(shields_list_contains,vortex_corne_right)
```
